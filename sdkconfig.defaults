## sdkconfig.defaults
```kconfig
# Default provided by esp-idf-template
CONFIG_ESP_MAIN_TASK_STACK_SIZE=7000

# Needed for wifi
CONFIG_ESP_SYSTEM_EVENT_TASK_STACK_SIZE=4096

# Use external ram
CONFIG_ESP32_SPIRAM_SUPPORT=y
```
